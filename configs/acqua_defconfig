## configs/acqua_defconfig
```kconfig
CONFIG_HAVE_DOT_CONFIG=y
CONFIG_LOAD_AND_JUMP=y
# CONFIG_DIRECT_JUMP is not set
# CONFIG_INIT_AND_STOP is not set
CONFIG_LOAD_SW=y
CONFIG_JUMP_TO_SW=y
# CONFIG_SAM9X60 is not set
# CONFIG_SAMA5D2 is not set
CONFIG_SAMA5D3X=y
# CONFIG_SAMA5D4 is not set
# CONFIG_SAMA7G5 is not set
CONFIG_DEVICENAME="sama5d3"

#
# Clock Signals
#

#
# Main Crystal configuration
#
CONFIG_CRYSTAL_12_000MHZ=y
# CONFIG_CRYSTAL_16_000MHZ is not set
# CONFIG_CRYSTAL_16_36766MHZ is not set
# CONFIG_CRYSTAL_18_432MHZ is not set
# CONFIG_CRYSTAL_24_000MHZ is not set
# CONFIG_MCK_BYPASS is not set

#
# Slow Clock Configuration Options
#
CONFIG_SCLK=y
# CONFIG_SCLK_BYPASS is not set
CONFIG_ALLOW_CRYSTAL_12_000MHZ=y
# CONFIG_CPU_CLK_266MHZ is not set
# CONFIG_CPU_CLK_332MHZ is not set
# CONFIG_CPU_CLK_348MHZ is not set
# CONFIG_CPU_CLK_396MHZ is not set
# CONFIG_CPU_CLK_444MHZ is not set
# CONFIG_CPU_CLK_492MHZ is not set
# CONFIG_CPU_CLK_498MHZ is not set
# CONFIG_CPU_CLK_510MHZ is not set
CONFIG_CPU_CLK_528MHZ=y
# CONFIG_CPU_CLK_594MHZ is not set
# CONFIG_CPU_CLK_600MHZ is not set
# CONFIG_CPU_CLK_800MHZ is not set
# CONFIG_CPU_CLK_1000MHZ is not set
CONFIG_ALLOW_CPU_CLK_266MHZ=y
CONFIG_ALLOW_CPU_CLK_332MHZ=y
CONFIG_ALLOW_CPU_CLK_396MHZ=y
CONFIG_ALLOW_CPU_CLK_444MHZ=y
CONFIG_ALLOW_CPU_CLK_498MHZ=y
CONFIG_ALLOW_CPU_CLK_528MHZ=y
# CONFIG_DISABLE_CPU_CLK_240MHZ is not set
# CONFIG_BUS_SPEED_116MHZ is not set
# CONFIG_BUS_SPEED_124MHZ is not set
CONFIG_BUS_SPEED_133MHZ=y
# CONFIG_BUS_SPEED_148MHZ is not set
# CONFIG_BUS_SPEED_164MHZ is not set
# CONFIG_BUS_SPEED_166MHZ is not set
# CONFIG_BUS_SPEED_170MHZ is not set
# CONFIG_BUS_SPEED_176MHZ is not set
# CONFIG_BUS_SPEED_200MHZ is not set
CONFIG_SUPPORT_BUS_SPEED_133MHZ=y
CONFIG_SUPPORT_BUS_SPEED_148MHZ=y
CONFIG_SUPPORT_BUS_SPEED_166MHZ=y

#
# Console and Debug
#
CONFIG_DEBUG=y
CONFIG_DEBUG_INFO=y
# CONFIG_DEBUG_LOUD is not set
# CONFIG_DEBUG_VERY_LOUD is not set
CONFIG_HW_DISPLAY_BANNER=y
CONFIG_HW_BANNER="\"\\n\\nAT91Bootstrap \" AT91BOOTSTRAP_VERSION \" (\" COMPILE_TIME \")\\n\\n\""
CONFIG_LINK_ADDR="0x300000"
CONFIG_TOP_OF_MEMORY="0x310000"
# CONFIG_CPU_HAS_TRUSTZONE is not set
# CONFIG_CPU_HAS_TZC400 is not set
# CONFIG_CPU_V7 is not set
# CONFIG_HAS_PMIC_ACT8865 is not set
CONFIG_SUPPORT_PM=y
# CONFIG_HAS_ONE_WIRE is not set
# CONFIG_HAS_EEPROM is not set
# CONFIG_HAS_EHT0_PHY is not set
# CONFIG_HAS_EHT1_PHY is not set
# CONFIG_HAS_AUDIO_CODEC is not set
# CONFIG_HAS_HDMI is not set
# CONFIG_CORE_ARM926EJS is not set
CONFIG_CORE_CORTEX_A5=y
# CONFIG_CORE_CORTEX_A7 is not set
# CONFIG_CPU_HAS_UMCTL2 is not set
CONFIG_CPU_HAS_DDRC=y
# CONFIG_CPU_HAS_SDDRC is not set
# CONFIG_CPU_HAS_SDRAMC is not set
CONFIG_CPU_HAS_SCKC=y
# CONFIG_CPU_HAS_H32MXDIV is not set
CONFIG_CPU_HAS_HSMCI0=y
CONFIG_CPU_HAS_HSMCI1=y
CONFIG_CPU_HAS_HSMCI2=y
# CONFIG_CPU_HAS_MCI0 is not set
# CONFIG_CPU_HAS_MCI1 is not set
# CONFIG_CPU_HAS_SDHC0 is not set
# CONFIG_CPU_HAS_SDHC1 is not set
# CONFIG_CPU_HAS_SDHC2 is not set
CONFIG_CPU_HAS_SPI=y
# CONFIG_CPU_HAS_SPI_IOSET is not set
# CONFIG_CPU_HAS_QSPI is not set
# CONFIG_CPU_HAS_QSPI_IOSET is not set
CONFIG_CPU_HAS_SCLK_BYPASS=y
CONFIG_CPU_HAS_PIO3=y
# CONFIG_CPU_HAS_L2CC is not set
CONFIG_CPU_HAS_PMECC=y
# CONFIG_HAS_HW_INFO is not set
# CONFIG_TWI is not set
# CONFIG_MACB is not set
# CONFIG_AES is not set
# CONFIG_LOAD_HW_INFO is not set
CONFIG_CPU_HAS_TWI0=y
CONFIG_CPU_HAS_TWI1=y
CONFIG_CPU_HAS_TWI2=y
# CONFIG_CPU_HAS_TWI3 is not set
CONFIG_CPU_HAS_AES=y
# CONFIG_CPU_HAS_PIO4 is not set
# CONFIG_CPU_HAS_FLEXCOM0 is not set
# CONFIG_CPU_HAS_FLEXCOM1 is not set
# CONFIG_CPU_HAS_FLEXCOM2 is not set
# CONFIG_CPU_HAS_FLEXCOM3 is not set
# CONFIG_CPU_HAS_FLEXCOM4 is not set
# CONFIG_CPU_HAS_FLEXCOM5 is not set
# CONFIG_CPU_HAS_FLEXCOM6 is not set
# CONFIG_CPU_HAS_FLEXCOM7 is not set
# CONFIG_CPU_HAS_FLEXCOM8 is not set
# CONFIG_CPU_HAS_FLEXCOM9 is not set
# CONFIG_CPU_HAS_FLEXCOM10 is not set
# CONFIG_CPU_HAS_FLEXCOM11 is not set
# CONFIG_CPU_HAS_FLEXCOM12 is not set
# CONFIG_CPU_HAS_WDT2 is not set
# CONFIG_CPU_HAS_DWDT is not set

#
# DRAM
#
# CONFIG_SDRAM is not set
# CONFIG_SDDRC is not set
CONFIG_DDRC=y
# CONFIG_UMCTL2 is not set
# CONFIG_PUBL is not set
# CONFIG_ALLOW_PSRAM is not set
# CONFIG_DDR_SEL_ADDR is not set
CONFIG_BANK_4=y
# CONFIG_BANK_8 is not set
CONFIG_DDR_SET_BY_DEVICE=y
# CONFIG_DDR_SET_BY_JEDEC is not set
# CONFIG_DDR_SET_BY_TIMING is not set
# CONFIG_DDR_MT41K128M16_D2 is not set
# CONFIG_DDR_W632GU6MB is not set
# CONFIG_DDR_W972GG6KB_9X60 is not set
# CONFIG_DDR_W972GG6KB_D2 is not set
# CONFIG_DDR_W971GG6SB_D2 is not set
# CONFIG_DDR_W9712G6KB25I is not set
# CONFIG_DDR_AD210032F is not set
# CONFIG_DDR_W9751G6KB is not set
# CONFIG_DDR_W971GG6SB is not set
# CONFIG_DDR_AD220032D is not set
CONFIG_DDR_MT47H128M16=y
# CONFIG_DDR_MT47H64M16 is not set
# CONFIG_DDR_MT47H128M8 is not set
# CONFIG_DDR_MT41K256M16TW_107 is not set
# CONFIG_DDR_MT41K512M16HA_125 is not set
# CONFIG_DDR_AS4C256M16D3LC_12BCNTR is not set
# CONFIG_DDR_MT47H128M16RT_25E_C is not set
# CONFIG_DDR_IS43LD16128B_25BLI is not set
# CONFIG_DDR_MT52L256M32D1PF_107 is not set
# CONFIG_DDR_EDB5432BEBH_1DAAT_F_D is not set
CONFIG_NOT_DQS_DISABLED=y

#
# Extra parameters
#
# CONFIG_DDR_EXT_TEMP_RANGE is not set
# CONFIG_SAMA5D2_LPDDR2 is not set
# CONFIG_MMU is not set

#
# Flash Memory
#
# CONFIG_DATAFLASH is not set
# CONFIG_FLASH is not set
# CONFIG_NANDFLASH is not set
CONFIG_SDCARD=y
CONFIG_MEMORY="sdcard"

#
# SD Card Configuration
#
CONFIG_AT91_MCI=y
CONFIG_AT91_MCI0=y
# CONFIG_AT91_MCI1 is not set
# CONFIG_AT91_MCI2 is not set
CONFIG_FATFS=y
CONFIG_ALLOW_BOOT_FROM_DATAFLASH_CS0=y
CONFIG_ALLOW_BOOT_FROM_DATAFLASH_CS1=y
CONFIG_BOOTSTRAP_MAXSIZE="65536"
CONFIG_PROJECT="sdcard"
# CONFIG_LOAD_UBOOT is not set
CONFIG_LOAD_LINUX=y
# CONFIG_LOAD_ANDROID is not set
# CONFIG_LOAD_1MB is not set
# CONFIG_LOAD_4MB is not set
# CONFIG_LOAD_64KB is not set
CONFIG_LINUX_IMAGE=y

#
# Kernel Image Storage Setup
#
# CONFIG_OVERRIDE_CMDLINE is not set
CONFIG_OVERRIDE_CMDLINE_FROM_EXT_FILE=y
CONFIG_LINUX_KERNEL_ARG_STRING_FILE="cmdline.txt"
CONFIG_JUMP_ADDR="0x22000000"

#
# Flattened Device Tree
#
CONFIG_OF_LIBFDT=y
CONFIG_OF_OVERRIDE_DTB_NAME="acme-acqua.dtb"
CONFIG_OF_ADDRESS="0x21000000"
CONFIG_IMAGE_NAME="zImage"
CONFIG_MACH_TYPE="9999"
# CONFIG_OVERRIDE_MACH_TYPE is not set
# CONFIG_SECURE is not set
CONFIG_CPU_HAS_OCMS=y
CONFIG_DISABLE_WATCHDOG=y
# CONFIG_PM is not set
# CONFIG_BACKUP_MODE is not set

#
# Board's Workaround Options
#
CONFIG_BOARD_QUIRK_NONE=y
# CONFIG_BOARD_QUIRK_SAMA5D3 is not set
# CONFIG_BOARD_QUIRK_SAMA5D4 is not set
# CONFIG_BOARD_QUIRK_SAMA5D2_XULT is not set
# CONFIG_BOARD_QUIRK_SAMA5D2_ICP is not set
# CONFIG_BOARD_QUIRK_SAMA5D2_SIP is not set
# CONFIG_BOARD_QUIRK_SAM9X60_EK is not set
# CONFIG_BOARD_QUIRK_SAM9X60_EB is not set
# CONFIG_BOARD_QUIRK_SAMA7G5_EK is not set
# CONFIG_BOARD_QUIRK_SAM9X60_CURIOSITY is not set
# CONFIG_LED_ON_BOARD is not set

#
# TWI BUS setting
#
# CONFIG_TWI0 is not set
# CONFIG_TWI1 is not set
# CONFIG_TWI2 is not set
# CONFIG_ACT8865 is not set
# CONFIG_MCP16502 is not set

#
# Board Hardware Information Options
#

#
# Basic Drivers support
#
CONFIG_PIT=y
CONFIG_WDT=y
# CONFIG_WDT2 is not set
CONFIG_RSTC=y
CONFIG_USART=y
CONFIG_PIO=y
CONFIG_PIO_E=y
CONFIG_PMC_COMMON=y
CONFIG_PMC_V1=y
CONFIG_PMC_PERIPH_CLK_SAM9X5=y
CONFIG_PMC_UTMI_CLK=y
CONFIG_PMC_PLL_CLK=y
CONFIG_PMC_MCK_CLK=y
# CONFIG_SHDWC is not set
```

## configs/bertad2_defconfig
```kconfig
CONFIG_DEBUG=y
CONFIG_DEBUG_VERY_LOUD=y
CONFIG_DDR_SET_BY_DEVICE=y
CONFIG_QSPI=y
CONFIG_QSPI_IOSET=3
CONFIG_QSPI_4B_OPCODES=y
CONFIG_IMG_ADDRESS="0x00040000"
CONFIG_BACKUP_MODE=y
```
